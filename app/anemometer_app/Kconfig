## app/anemometer_app/Kconfig
```kconfig
config ENABLE_ANEMOMETER_APP
	bool "Enable anemometer application"
	default y
	depends on ANEMOMETER_SAMPLE_SERVICE
	help
	  Enable product-level anemometer sampling bindings.

if ENABLE_ANEMOMETER_APP

choice ANEMOMETER_MODEL
	prompt "Anemometer backend model"
	default ANEMOMETER_MODEL_MODBUS

config ANEMOMETER_MODEL_MODBUS
	bool "Modbus anemometer"
	select ANEMOMETER_MODBUS

endchoice

config ANEMOMETER_IFACE_NAME
	string "Anemometer RS485 interface name"
	default "rs485-usart6"

config ANEMOMETER_MODBUS_UNIT_ID
	int "Anemometer Modbus unit id"
	default 4
	range 1 247

config ANEMOMETER_MODBUS_BAUD
	int "Anemometer Modbus baud rate"
	default 115200

config ANEMOMETER_MODBUS_RX_TIMEOUT_US
	int "Anemometer Modbus RX timeout in microseconds"
	default 100000

config ANEMOMETER_SAMPLE_PERIOD_MS
	int "Anemometer sample period in milliseconds"
	default 1000
	range 100 60000

config ANEMOMETER_MODBUS_START_ADDR
	hex "Anemometer Modbus holding register start address"
	default 0x0009

config ANEMOMETER_MODBUS_REGISTER_COUNT
	int "Anemometer Modbus holding register count"
	default 5
	range 5 5

endif
```

## app/anemometer_load_app/Kconfig
```kconfig
config ENABLE_ANEMOMETER_SENSOR
	bool "Enable anemometer application"
	default y
	help
	  Enable the combined anemometer and load ADC Modbus application.

config ANEMOMETER_IFACE_NAME
	string "Anemometer RS485 interface name"
	default "rs485-usart6"

config ANEMOMETER_MODBUS_UNIT_ID
	int "Anemometer Modbus unit id"
	default 1
	range 1 247

config LOAD_SENSOR_MODBUS_UNIT_ID
	int "Load sensor Modbus unit id"
	default 2
	range 1 247

config ANEMOMETER_MODBUS_BAUD
	int "Anemometer Modbus baud rate"
	default 9600

config ANEMOMETER_MODBUS_RX_TIMEOUT_MS
	int "Anemometer Modbus RX timeout in milliseconds"
	default 100

config ANEMOMETER_READ_SLOT_BUDGET_MS
	int "Per-sensor read slot budget in milliseconds"
	default 500
	range 100 60000

config ANEMOMETER_MODBUS_START_ADDR
	hex "Anemometer Modbus holding register start address"
	default 0x0009

config ANEMOMETER_MODBUS_REGISTER_COUNT
	int "Anemometer Modbus holding register count"
	default 5
	range 5 5

config ANEMOMETER_THREAD_STACK_SIZE
	int "Combined anemometer/load Modbus thread stack size"
	default 2048
	range 1024 4096

config ANEMOMETER_THREAD_PRIORITY
	int "Combined anemometer/load Modbus thread priority"
	default 6
	range 0 15

config LOAD_ADC_SHELL
	bool "Enable load ADC shell commands"
	default y
	depends on SHELL
```

## app/crane_encoder_app/Kconfig
```kconfig
config ENABLE_CRANE_ENCODER_APP
	bool "Enable crane encoder application"
	default y
	depends on ENCODER_SAMPLE_SERVICE
	help
	  Enable product-level encoder sampling bindings. This layer decides
	  which encoder channels are used and where their samples are published.

if ENABLE_CRANE_ENCODER_APP

config CRANE_ENCODER_USE_SLEWING
	bool "Use slewing encoder"
	default y

config CRANE_ENCODER_USE_LUFFING
	bool "Use luffing encoder"
	default y if TOWER_TYPE_FLAT_TOP
	depends on !TOWER_TYPE_LUFFING_JIB

config CRANE_ENCODER_USE_HOISTING
	bool "Use hoisting encoder"
	default y

config CRANE_ENCODER_SLEWING_IFACE_NAME
	string "Slewing encoder RS485 interface name"
	default "rs485-uart7"
	depends on CRANE_ENCODER_USE_SLEWING

config CRANE_ENCODER_LUFFING_IFACE_NAME
	string "Luffing encoder RS485 interface name"
	default "rs485-uart8"
	depends on CRANE_ENCODER_USE_LUFFING

config CRANE_ENCODER_HOISTING_IFACE_NAME
	string "Hoisting encoder RS485 interface name"
	default "rs485-uart4"
	depends on CRANE_ENCODER_USE_HOISTING

config CRANE_ENCODER_MODBUS_UNIT_ID
	int "Encoder Modbus unit id"
	default 1
	range 1 247

config CRANE_ENCODER_MODBUS_BAUD
	int "Encoder Modbus baud rate"
	default 9600

config CRANE_ENCODER_MODBUS_RX_TIMEOUT_US
	int "Encoder Modbus RX timeout in microseconds"
	default 30000

config CRANE_ENCODER_SAMPLE_PERIOD_MS
	int "Encoder sample period in milliseconds"
	default 50
	range 10 10000

config CRANE_ENCODER_MODBUS_START_ADDR
	hex "Encoder Modbus holding register start address"
	default 0x0002

endif
```

## app/encoder_app/Kconfig
```kconfig
menu "Encoder application"
	depends on ENCODER_SAMPLE_SERVICE

choice ENCODER_MODEL
	prompt "Encoder backend model"
	default ENCODER_MODEL_IDECODER_MODBUS

config ENCODER_MODEL_IDECODER_MODBUS
	bool "IDECODER Modbus encoder"
	select IDECODER_ENCODER_MODBUS

endchoice

config ENABLE_SLEWING_ENCODER
	bool "Enable slewing encoder"
	default y

config ENABLE_LUFFING_ENCODER
	bool "Enable luffing encoder"
	default y if TOWER_TYPE_FLAT_TOP
	depends on !TOWER_TYPE_LUFFING_JIB

config ENABLE_HOISTING_ENCODER
	bool "Enable hoisting encoder"
	default y

config ENCODER_SLEWING_IFACE_NAME
	string "Slewing encoder RS485 interface name"
	default "rs485-uart7"
	depends on ENABLE_SLEWING_ENCODER

config ENCODER_LUFFING_IFACE_NAME
	string "Luffing encoder RS485 interface name"
	default "rs485-uart8"
	depends on ENABLE_LUFFING_ENCODER

config ENCODER_HOISTING_IFACE_NAME
	string "Hoisting encoder RS485 interface name"
	default "rs485-uart4"
	depends on ENABLE_HOISTING_ENCODER

config ENCODER_MODBUS_UNIT_ID
	int "Encoder Modbus unit id"
	default 1
	range 1 247

config ENCODER_MODBUS_BAUD
	int "Encoder Modbus baud rate"
	default 9600

config ENCODER_MODBUS_RX_TIMEOUT_MS
	int "Encoder Modbus RX timeout in milliseconds"
	default 30

config ENCODER_SAMPLE_PERIOD_MS
	int "Encoder sample period in milliseconds"
	default 50
	range 10 10000

config ENCODER_MODBUS_START_ADDR
	hex "Encoder Modbus holding register start address"
	default 0x0002

endmenu
```

## app/luffing_imu_app/Kconfig
```kconfig
menu "Luffing IMU application"

config ENABLE_LUFFING_IMU
	bool "Enable luffing IMU register bridge application"
	default y if TOWER_TYPE_LUFFING_JIB
	depends on IMU_SAMPLE_SERVICE
	depends on TOWER_TYPE_LUFFING_JIB
	help
	  Bridge the reusable IMU sample service into this product's luffing
	  IMU Modbus TCP input registers and luffing health event.

if ENABLE_LUFFING_IMU

choice LUFFING_IMU_BACKEND
	prompt "Luffing IMU backend"
	default LUFFING_IMU_BACKEND_WIT_MODBUS

config LUFFING_IMU_BACKEND_WIT_MODBUS
	bool "WIT IMU Modbus"
	select WIT_IMU_MODBUS

endchoice

choice LUFFING_IMU_MODEL
	prompt "Luffing IMU model"
	default LUFFING_IMU_MODEL_WIT_STANDARD_PRECISION
	depends on LUFFING_IMU_BACKEND_WIT_MODBUS

config LUFFING_IMU_MODEL_WIT_STANDARD_PRECISION
	bool "WIT standard precision"
	help
	  Standard-precision WIT Modbus angle format.

config LUFFING_IMU_MODEL_WIT_HIGH_PRECISION
	bool "WIT high precision"
	help
	  High-precision WIT Modbus angle format.

endchoice

config LUFFING_IMU_IFACE_NAME
	string "Luffing IMU RS485 interface name"
	default "rs485-uart8"

config LUFFING_IMU_MODBUS_UNIT_ID
	int "Luffing IMU Modbus unit ID"
	default 80
	range 1 247

config LUFFING_IMU_MODBUS_BAUD
	int "Luffing IMU Modbus baud rate"
	default 9600

config LUFFING_IMU_MODBUS_RX_TIMEOUT_MS
	int "Luffing IMU Modbus RX timeout in milliseconds"
	default 50

config LUFFING_IMU_SAMPLE_PERIOD_MS
	int "Luffing IMU sample period in milliseconds"
	default 50
	range 20 10000

endif

endmenu
```

## app/sensor_manage_app/Kconfig
```kconfig
menuconfig SENSOR_MANAGE_SERVICE
	bool "Sensor runtime manage application"
	default y
	depends on DEVICE_PARAM_SERVER
	select SHELL
	help
	  Persist runtime enable flags for the encoder, anemometer and load
	  sensor applications. Changes take effect after reboot.
```

## boards/craner/craner_general_board_v110/Kconfig.craner_general_board_v110
```kconfig
# SPDX-License-Identifier: Apache-2.0

config BOARD_CRANER_GENERAL_BOARD_V110
	select SOC_STM32H743XX
```

## boards/craner/craner_general_board_v110/Kconfig.defconfig
```kconfig
# SPDX-License-Identifier: Apache-2.0

if BOARD_CRANER_GENERAL_BOARD_V110

config UART_CONSOLE
	default y

config STDOUT_CONSOLE
	default y

endif # BOARD_CRANER_GENERAL_BOARD_V110
```

## boards/craner/craner_general_board_v110/board.yml
```yaml
board:
  name: craner_general_board_v110
  full_name: Craner General Board V1.10
  vendor: craner
  socs:
    - name: stm32h743xx
```

## boards/craner/craner_general_stm32h743vit6/Kconfig.craner_general_stm32h743vit6
```kconfig
# SPDX-License-Identifier: Apache-2.0

config BOARD_CRANER_GENERAL_STM32H743VIT6
	select SOC_STM32H743XX
```

## boards/craner/craner_general_stm32h743vit6/Kconfig.defconfig
```kconfig
# SPDX-License-Identifier: Apache-2.0

if BOARD_CRANER_GENERAL_STM32H743VIT6

config UART_CONSOLE
	default y

config STDOUT_CONSOLE
	default y

endif # BOARD_CRANER_GENERAL_STM32H743VIT6
```

## boards/craner/craner_general_stm32h743vit6/board.yml
```yaml
board:
  name: craner_general_stm32h743vit6
  full_name: Craner General STM32H743VIT6 PCB V1.1.0
  vendor: craner
  socs:
    - name: stm32h743xx
```

## boards/mp/mp_rs485x4_stm32h743vit6/Kconfig.defconfig
```kconfig
# SPDX-License-Identifier: Apache-2.0

if BOARD_MP_RS485X4_STM32H743VIT6

config UART_CONSOLE
	default y

config STDOUT_CONSOLE
	default y

endif # BOARD_MP_RS485X4_STM32H743VIT6
```

## boards/mp/mp_rs485x4_stm32h743vit6/Kconfig.mp_rs485x4_stm32h743vit6
```kconfig
# SPDX-License-Identifier: Apache-2.0

config BOARD_MP_RS485X4_STM32H743VIT6
	select SOC_STM32H743XX
```

## boards/mp/mp_rs485x4_stm32h743vit6/board.yml
```yaml
board:
  name: mp_rs485x4_stm32h743vit6
  full_name: MP RS485x4 STM32H743VIT6 PCB V1.2.0
  vendor: mp
  socs:
    - name: stm32h743xx
```

## driver/anemometer_modbus/Kconfig
```kconfig
config ANEMOMETER_MODBUS
	bool "Anemometer Modbus helper"
	depends on MODBUS && MODBUS_CLIENT && MODBUS_SERIAL
	help
	  Enable the Modbus RTU helper for one anemometer. This layer only
	  initializes a Modbus RTU client and fetches one raw sample.
```

## driver/idecoder_encoder_modbus/Kconfig
```kconfig
config IDECODER_ENCODER_MODBUS
	bool "IDECODER encoder Modbus helper"
	depends on MODBUS
	help
	  Enable the IDECODER encoder Modbus RTU helper. This layer only knows
	  how to initialize a Modbus RTU client and fetch one raw encoder sample.
```

## driver/wit_imu_modbus/Kconfig
```kconfig
menu "WIT IMU Modbus helper"

config WIT_IMU_MODBUS
	bool "Enable WIT IMU Modbus helper"
	default n
	depends on MODBUS && MODBUS_CLIENT && MODBUS_SERIAL
	help
	  启用用于读取 WIT IMU 角度寄存器的 Modbus RTU helper。该层只负责
	  具体型号的协议访问和解析，不创建采样线程，不注册 shell 命令，
	  不处理健康事件、供电时序或产品寄存器镜像。

endmenu
```

## module/anemometer_sample_service/Kconfig
```kconfig
config ANEMOMETER_SAMPLE_SERVICE
	bool "Anemometer sample service"
	help
	  Enable the reusable one-channel anemometer sampling service.

if ANEMOMETER_SAMPLE_SERVICE

config ANEMOMETER_SAMPLE_SERVICE_THREAD_STACK_SIZE
	int "Anemometer sample service thread stack size"
	default 2048
	range 1024 4096

config ANEMOMETER_SAMPLE_SERVICE_THREAD_PRIORITY
	int "Anemometer sample service thread priority"
	default 6
	range 0 15

config ANEMOMETER_SAMPLE_SERVICE_MAX_INSTANCES
	int "Maximum anemometer sample service instances"
	default 2
	range 1 8

config ANEMOMETER_SAMPLE_SERVICE_STATS
	bool "Enable anemometer sample statistics"
	default y
	help
	  Enable success and error counters, consecutive error statistics, and
	  read duration statistics.

config ANEMOMETER_SAMPLE_SERVICE_SHELL
	bool "Enable anemometer sample shell commands"
	default y
	depends on SHELL && ANEMOMETER_SAMPLE_SERVICE_STATS
	help
	  Enable anemometer sample service shell diagnostics.

config ANEMOMETER_SAMPLE_SERVICE_REINIT_ON_ENODEV
	bool "Reinitialize anemometer backend when ENODEV is returned"
	default y
	help
	  Reset the backend client and run backend init again before the next
	  sample when a fetch returns -ENODEV.

endif
```

## module/encoder_sample_service/Kconfig
```kconfig
config ENCODER_SAMPLE_SERVICE
	bool "Encoder sample service"
	help
	  Enable the reusable one-channel encoder sampling service.

if ENCODER_SAMPLE_SERVICE

config ENCODER_SAMPLE_SERVICE_THREAD_STACK_SIZE
	int "Encoder sample service thread stack size"
	default 2048
	range 1024 4096

config ENCODER_SAMPLE_SERVICE_THREAD_PRIORITY
	int "Encoder sample service thread priority"
	default 6
	range 0 15

config ENCODER_SAMPLE_SERVICE_MAX_INSTANCES
	int "Maximum encoder sample service instances"
	default 4
	range 1 8

config ENCODER_SAMPLE_SERVICE_STATS
	bool "Enable encoder sample statistics"
	default y
	help
	  Enable success and error counters, consecutive error statistics, and
	  read duration statistics.

config ENCODER_SAMPLE_SERVICE_SHELL
	bool "Enable encoder sample shell commands"
	default y
	depends on SHELL && ENCODER_SAMPLE_SERVICE_STATS
	help
	  Enable encoder sample service shell diagnostics.

config ENCODER_SAMPLE_SERVICE_REINIT_ON_ENODEV
	bool "Reinitialize encoder backend when ENODEV is returned"
	default y
	help
	  Reset the backend client and run backend init again before the next
	  sample when a fetch returns -ENODEV.

endif
```

## module/imu_sample_service/Kconfig
```kconfig
menu "IMU sample service"

config IMU_SAMPLE_SERVICE
	bool "Enable IMU sample service"
	default y if TOWER_TYPE_LUFFING_JIB
	help
	  Enable a reusable one-channel IMU sampling service. Product code can
	  create multiple instances, one per IMU channel.

config IMU_SAMPLE_THREAD_STACK_SIZE
	int "IMU sample thread stack size"
	default 2048
	depends on IMU_SAMPLE_SERVICE

config IMU_SAMPLE_THREAD_PRIORITY
	int "IMU sample thread priority"
	default 7
	depends on IMU_SAMPLE_SERVICE

config IMU_SAMPLE_SERVICE_MAX_INSTANCES
	int "Maximum IMU sample service instances"
	default 4
	range 1 8
	depends on IMU_SAMPLE_SERVICE

config IMU_SAMPLE_SERVICE_STATS
	bool "Enable IMU sample statistics"
	default y
	depends on IMU_SAMPLE_SERVICE
	help
	  Enable success and error counters, consecutive error statistics, and
	  read duration statistics.

config IMU_SAMPLE_SERVICE_SHELL
	bool "Enable IMU sample shell commands"
	default y
	depends on IMU_SAMPLE_SERVICE && SHELL && IMU_SAMPLE_SERVICE_STATS
	help
	  Enable IMU sample service shell diagnostics.

config IMU_SAMPLE_SERVICE_REINIT_ON_ENODEV
	bool "Reinitialize IMU backend when ENODEV is returned"
	default y
	depends on IMU_SAMPLE_SERVICE
	help
	  Reset the backend client and run backend init again before the next
	  sample when a fetch returns -ENODEV.

endmenu
```

## module/modbus_register_service/Kconfig
```kconfig
menu "Modbus register service"

config MODBUS_REGISTER_SERVICE
	bool "Enable Modbus register service"
	default n
	help
	  Enable the reusable Modbus register map service. The service owns
	  coil, input register, and holding register read/write APIs and can be
	  shared by Modbus TCP, Modbus RTU, shell, and product application code.

if MODBUS_REGISTER_SERVICE

config MODBUS_REGISTER_STORE
	bool "Enable persistent Modbus register store"
	default n
	depends on FLASH && FLASH_MAP
	help
	  Save Modbus registers marked with MODBUS_REG_F_PERSISTENT to flash.
	  The current backend expects a fixed partition node label named
	  modbus_store_partition.

config MODBUS_REGISTER_STORE_SAVE_DELAY_MS
	int "Modbus register store delayed save time in milliseconds"
	default 3000
	range 100 60000
	depends on MODBUS_REGISTER_STORE
	help
	  Delay used to merge frequent Modbus writes before saving persistent
	  registers to flash.

endif

endmenu
```
